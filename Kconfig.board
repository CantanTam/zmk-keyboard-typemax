## Kconfig.board
```kconfig
# touchtype board configuration

# Copyright (c) 2020 The ZMK Contributors
# SPDX-License-Identifier: MIT

config BOARD_TYPEMAX
	bool "typemax"
	depends on SOC_NRF52840_QIAA
```

## Kconfig.defconfig
```kconfig
# typemax board configuration

if BOARD_TYPEMAX

config BOARD
	default "typemax"

config BT_CTLR
	default BT

config ZMK_KEYBOARD_NAME
    default "TypeMax"

config ZMK_KSCAN_MATRIX_POLLING
    default y

endif # BOARD_TYPEMAX
```
