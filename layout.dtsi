/* * 自定义物理布局文件 layout.dtsi
 */

/* 如果系统头文件没起作用，我们在这里直接定义 DTS_COORD 宏 */
#ifndef DTS_COORD
#define DTS_COORD(row, col, x, y) (((row) << 24) | ((col) << 16) | ((x) << 8) | (y))
#endif

/ {
    physical_layout0: physical_layout_0 {
        compatible = "zmk,physical-layout";
        display-name = "Default Layout";
        kscan = <&kscan>;

        /* 格式: DTS_COORD(行, 列, X坐标, Y坐标) */
        keys
            /* 第一排 (y=0) */
            = <DTS_COORD(0, 0, 0, 0)>      // Esc
            , <DTS_COORD(0, 2, 200, 0)>    // F1
            , <DTS_COORD(0, 3, 300, 0)>    // F2
            , <DTS_COORD(0, 4, 400, 0)>    // F3
            , <DTS_COORD(0, 5, 500, 0)>    // F4
            , <DTS_COORD(0, 7, 650, 0)>    // F5
            , <DTS_COORD(0, 8, 750, 0)>    // F6
            , <DTS_COORD(6, 0, 850, 0)>    // F7
            , <DTS_COORD(6, 1, 950, 0)>    // F8
            , <DTS_COORD(4, 9, 1100, 0)>   // F9
            , <DTS_COORD(5, 9, 1200, 0)>   // F10
            , <DTS_COORD(6, 9, 1300, 0)>   // F11
            , <DTS_COORD(6, 7, 1400, 0)>   // F12

            /* 第二排 (y=150) */
            , <DTS_COORD(1, 0, 0, 150)>    // ~
            , <DTS_COORD(1, 1, 100, 150)>  // 1
            , <DTS_COORD(1, 2, 200, 150)>  // 2
            , <DTS_COORD(1, 3, 300, 150)>  // 3
            , <DTS_COORD(1, 4, 400, 150)>  // 4
            , <DTS_COORD(1, 5, 500, 150)>  // 5
            , <DTS_COORD(1, 6, 600, 150)>  // 6
            , <DTS_COORD(1, 7, 700, 150)>  // 7
            , <DTS_COORD(1, 8, 800, 150)>  // 8
            , <DTS_COORD(7, 1, 900, 150)>  // 9
            , <DTS_COORD(7, 2, 1000, 150)> // 0
            , <DTS_COORD(7, 3, 1100, 150)> // -
            , <DTS_COORD(7, 4, 1200, 150)> // =
            , <DTS_COORD(7, 5, 1300, 150)> // Backspace
            , <DTS_COORD(7, 7, 1525, 150)> // Insert
            , <DTS_COORD(7, 8, 1625, 150)> // Home
            , <DTS_COORD(7, 9, 1725, 150)> // PgUp

            /* 第三排 (y=250) */
            , <DTS_COORD(2, 0, 0, 250)>    // Tab
            , <DTS_COORD(2, 2, 150, 250)>  // Q
            , <DTS_COORD(2, 3, 250, 250)>  // W
            , <DTS_COORD(2, 4, 350, 250)>  // E
            , <DTS_COORD(2, 5, 450, 250)>  // R
            , <DTS_COORD(2, 6, 550, 250)>  // T
            , <DTS_COORD(2, 7, 650, 250)>  // Y
            , <DTS_COORD(2, 8, 750, 250)>  // U
            , <DTS_COORD(8, 0, 850, 250)>  // I
            , <DTS_COORD(8, 1, 950, 250)>  // O
            , <DTS_COORD(8, 2, 1050, 250)> // P
            , <DTS_COORD(8, 3, 1150, 250)> // [
            , <DTS_COORD(8, 4, 1250, 250)> // ]
            , <DTS_COORD(8, 6, 1350, 250)> // \
            , <DTS_COORD(8, 7, 1525, 250)> // Delete
            , <DTS_COORD(8, 8, 1625, 250)> // End
            , <DTS_COORD(8, 9, 1725, 250)> // PgDn
            ;
    };
};